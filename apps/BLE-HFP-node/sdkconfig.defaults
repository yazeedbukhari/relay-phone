## apps/BLE-HFP-node/sdkconfig.defaults
```kconfig
# Default configuration for relay-phone
CONFIG_IDF_TARGET="esp32"
CONFIG_LOG_DEFAULT_LEVEL=3
CONFIG_ESPTOOLPY_FLASHSIZE_4MB=y

# Bluetooth Classic + HFP
CONFIG_BT_ENABLED=y
CONFIG_BT_BLUEDROID_ENABLED=y
CONFIG_BT_CLASSIC_ENABLED=y
CONFIG_BT_HFP_ENABLE=y
CONFIG_BT_HFP_CLIENT_ENABLE=y

# Controller: BR/EDR only, allow 1 SCO link for voice audio
CONFIG_BTDM_CTRL_MODE_BR_EDR_ONLY=y
CONFIG_BTDM_CTRL_BR_EDR_MAX_ACL_CONN=2
CONFIG_BTDM_CTRL_BR_EDR_MAX_SYNC_CONN=1

# Voice audio routed through HCI (software callback) so we can play via I2S
CONFIG_BT_HFP_AUDIO_DATA_PATH_HCI=y
```

## apps/telephone-node/sdkconfig.defaults
```kconfig
# Default configuration for telephone-node
CONFIG_IDF_TARGET="esp32"
CONFIG_LOG_DEFAULT_LEVEL=3
```
